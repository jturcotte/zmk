## app/boards/shields/megatreus/Kconfig.defconfig
```kconfig
# Copyright (c) 2020 Pete Johanson, Richard Jones
# SPDX-License-Identifier: MIT

if SHIELD_MEGATREUS

config ZMK_KEYBOARD_NAME
    default "Megatreus"

config ZMK_BLE
    default y

config ZMK_USB
    default y

#config ZMK_BATTERY_VOLTAGE_DIVIDER
#    default y

config ZMK_KSCAN_MATRIX_WAIT_BEFORE_INPUTS
    default 20
config ZMK_KSCAN_MATRIX_WAIT_BETWEEN_OUTPUTS
    default 20

config SPI
    default n

endif
```

## app/boards/shields/megatreus/Kconfig.shield
```kconfig
# Copyright (c) 2020 Pete Johanson, Richard Jones
# SPDX-License-Identifier: MIT

config SHIELD_MEGATREUS
    def_bool $(shields_list_contains,megatreus)
```
